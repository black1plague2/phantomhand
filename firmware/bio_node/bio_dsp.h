// Node B signal chain, pure C++ (no Arduino headers) so the exact same code runs in the host test
// (firmware/bio_node/test/). Coefficients come from filter_coeffs.h, generated by filter_design.py.
//
//   1 kHz ADC counts -> DC removal -> band-pass 74.5-149.5 Hz (4th order) -> |x| -> 10 Hz low-pass
//   -> every 10th sample = 100 Hz envelope   ->   BurstDetector (median + MAD baseline, 3 SD, 30 ms)
#pragma once
#include <stdint.h>
#include <math.h>
#include <string.h>
#include <algorithm>
#include "filter_coeffs.h"

#define BIO_DECIM            10      // 1 kHz -> 100 Hz
#define BIO_WIN_N            200     // 2 s of 100 Hz envelope for the baseline
#define BIO_WARMUP_N         100     // need >= 1 s of quiet envelope before any burst can fire
#define BIO_BURST_K_SD       3.0f    // burst threshold = median + 3 SD
#define BIO_BURST_MIN_N      3       // >= 30 ms above threshold
#define BIO_BURST_END_N      2       // 20 ms below threshold ends a burst
#define BIO_BURST_MAX_N      150     // a burst is closed (and reported) after 1.5 s
#define BIO_REFRACTORY_N     30      // 300 ms after a burst ends
#define BIO_SD_FLOOR_ABS     1.0f    // SD never below 1 ADC count of envelope ...
#define BIO_SD_FLOOR_REL     0.10f   // ... or 10 % of the median (flat baseline must not fire on a hair)

struct Biquad {
  float z1 = 0, z2 = 0;
  inline float step(const float* c, float x) {   // c = {b0,b1,b2,a1,a2}, direct form II transposed
    float y = c[0] * x + z1;
    z1 = c[1] * x - c[3] * y + z2;
    z2 = c[2] * x - c[4] * y;
    return y;
  }
};

// One instance per channel. push() takes one raw ADC count at 1 kHz; returns true on every 10th call and
// fills env (envelope, ADC counts) and rms (RMS of the band-passed signal over the last 10 samples).
struct BioDsp {
  float dc = 0;
  bool dcInit = false;
  Biquad bp[BIO_BP_SECTIONS];
  Biquad lp[BIO_LP_SECTIONS];
  uint8_t phase = 0;
  float sumSq = 0;
  float lastBp = 0;

  bool push(float adc, float& env, float& rms) {
    if (!dcInit) { dc = adc; dcInit = true; }
    dc += BIO_DC_ALPHA * (adc - dc);
    float x = adc - dc;
    for (int i = 0; i < BIO_BP_SECTIONS; i++) x = bp[i].step(BIO_BP_SOS[i], x);
    lastBp = x;
    sumSq += x * x;
    float e = fabsf(x);                              // full-wave rectify
    for (int i = 0; i < BIO_LP_SECTIONS; i++) e = lp[i].step(BIO_LP_SOS[i], e);
    if (++phase < BIO_DECIM) return false;
    phase = 0;
    env = e < 0 ? 0 : e;
    rms = sqrtf(sumSq / BIO_DECIM);
    sumSq = 0;
    return true;
  }
};

struct BurstEvent {
  uint32_t onsetMs;       // timestamp of the first envelope sample above threshold
  float peak;             // max envelope during the burst
  float baselineRms;      // median band-passed RMS of the quiet window
  float baselineEnv;
  float thresholdEnv;
};

// Fed with the 100 Hz envelope. Emits ONE event per burst, when the burst ends (or hits 1.5 s).
struct BurstDetector {
  float winEnv[BIO_WIN_N];
  float winRms[BIO_WIN_N];
  int n = 0, head = 0;
  int sinceStat = 0;
  float med = 0, sd = 0, medRms = 0, thr = 1e9f;
  int above = 0, below = 0, refractory = 0;
  bool inBurst = false;
  uint32_t onsetMs = 0, pendingOnsetMs = 0;
  float peak = 0, pendPeak = 0;
  int burstLen = 0;

  static float median(float* a, int m) {
    std::nth_element(a, a + m / 2, a + m);
    return a[m / 2];
  }

  void restat() {
    float tmp[BIO_WIN_N];
    memcpy(tmp, winEnv, n * sizeof(float));
    med = median(tmp, n);
    for (int i = 0; i < n; i++) tmp[i] = fabsf(winEnv[i] - med);
    float mad = median(tmp, n);
    sd = std::max(1.4826f * mad, std::max(BIO_SD_FLOOR_ABS, BIO_SD_FLOOR_REL * med));
    thr = med + BIO_BURST_K_SD * sd;
    memcpy(tmp, winRms, n * sizeof(float));
    medRms = median(tmp, n);
  }

  void addQuiet(float env, float rms) {
    winEnv[head] = env; winRms[head] = rms;
    head = (head + 1) % BIO_WIN_N;
    if (n < BIO_WIN_N) n++;
    if (n >= BIO_WARMUP_N && (++sinceStat >= 10 || n == BIO_WARMUP_N)) { sinceStat = 0; restat(); }
  }

  bool ready() const { return n >= BIO_WARMUP_N; }

  // Returns true when a burst has just ended and `out` is filled. tMs = timestamp of this envelope sample.
  bool push(float env, float rms, uint32_t tMs, BurstEvent& out) {
    if (!ready()) { addQuiet(env, rms); return false; }
    bool over = env > thr;
    if (inBurst) {
      burstLen++;
      if (env > peak) peak = env;
      below = over ? 0 : below + 1;
      if (below >= BIO_BURST_END_N || burstLen >= BIO_BURST_MAX_N) {
        out.onsetMs = onsetMs; out.peak = peak; out.baselineRms = medRms;
        out.baselineEnv = med; out.thresholdEnv = thr;
        inBurst = false; above = 0; below = 0; refractory = BIO_REFRACTORY_N;
        return true;
      }
      return false;
    }
    if (refractory > 0) { refractory--; return false; }   // refractory samples stay out of the baseline
    if (over) {
      if (above == 0) { pendingOnsetMs = tMs; pendPeak = env; } else if (env > pendPeak) pendPeak = env;
      if (++above >= BIO_BURST_MIN_N) {
        inBurst = true; onsetMs = pendingOnsetMs; peak = pendPeak; burstLen = above; below = 0;
      }
      return false;                                        // possible-burst samples stay out of the baseline
    }
    above = 0;
    addQuiet(env, rms);
    return false;
  }
};
