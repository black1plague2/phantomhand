// =====================================================================================================
// Phantom Hand / Chetna - Node B "bio_node" firmware v0.5.0 - ESP-WROOM-32 (Arduino-ESP32 core 3.x)
//
// *** SAFETY: power bank only. Never connect to a laptop or charger while electrodes are on a person. ***
//     Flash with the bank cable unplugged and the electrodes OFF. Disposable electrodes only.
//     (PRD v2 section 11, 02-RULES.md section 4.) The banner below is printed at boot and sent once in the
//     first status message.
//
// WHAT IT DOES
//   BioAmp EXG Pill OUT -> GPIO34 (ADC1, input only) -> 1 kHz sampling -> DC removal -> band-pass 74.5-149.5 Hz
//   (4th-order Butterworth) -> full-wave rectify -> envelope low-pass -> /10 -> 100 Hz envelope.
//   Every 100 ms: sensor_chunk (PRD 9.3) to every live subscriber. Burst detector: median + MAD baseline over
//   the quiet last 2 s, burst = envelope > baseline + 3 SD for >= 30 ms, refractory 300 ms -> emg_burst.
//   The DSP (bio_dsp.h, coefficients in filter_coeffs.h generated by filter_design.py) and the message
//   formatting (bio_proto.h) are plain C++ and are unit-tested on the host: firmware/bio_node/test/.
//
// TIMING MODEL (why it is built this way)
//   A hardware timer fires at exactly 1 kHz. Calling analogRead() inside an ISR is not safe on the ESP32
//   (it takes a driver lock), so the ISR does the minimum - it counts the tick and wakes the sampler task
//   (FreeRTOS task notification). The sampler task (core 1, priority above loop()) reads the ADC, runs the
//   DSP and stores the result in lock-free ring buffers. The Wi-Fi/UDP work in loop() only reads those
//   rings, so a slow network never delays sampling. If the sampler ever misses a tick the missed count is
//   added to samples_dropped (reported in status and by the `stats` serial command).
//
// NETWORK (same rules as Node A, 03-SPEC.md section 4)
//   UDP commands/subscribe on 8790, discovery broadcast every 1 s on 8791 (PRD 9.1, device_kind "bio",
//   motor_count 0). A peer sends {"type":"subscribe"} at least every 2 s and gets the stream (max 3 peers,
//   5 s expiry). A ping from a subscribed peer refreshes it and is acked. This node drives NO output pin
//   from any network message; motor commands are acked "rejected" with error_code NOT_A_HAPTIC_NODE.
//
// SERIAL (115200 baud):  raw = toggle a 1 kHz raw ADC print (Serial Plotter, bench only)
//                        stats = print sample rate, drops, subscribers, baseline     help = this list
//
// LIBRARIES: none beyond the esp32 core (WiFi, WiFiUdp). No ArduinoJson needed.
// BOARD:     Tools > Board > esp32 > "ESP32 Dev Module" (esp32 by Espressif, 3.x).
// FLASHING:  firmware/README.md ("Node B"). Type the Wi-Fi name/password below only on your own machine,
//            immediately before uploading, then undo the edit. Never commit credentials.
// =====================================================================================================

#include <WiFi.h>
#include <WiFiUdp.h>
#include "bio_dsp.h"
#include "bio_proto.h"

// ---------------------------------- EDIT THESE (locally, never commit) ----------------------------------
const char* WIFI_SSID = "YOUR_HOTSPOT_NAME";
const char* WIFI_PASS = "YOUR_HOTSPOT_PASSWORD";
// --------------------------------------------------------------------------------------------------------

#define DEVICE_ID          "CHETNA_BIO_001"
#define FIRMWARE_VERSION   "0.5.0"
#define COMMAND_PORT       8790
#define DISCOVERY_PORT     8791
#define ADC_PIN            34                 // ADC1_CH6, input only; ADC2 is unreliable while Wi-Fi is on
#define SAMPLE_PERIOD_US   1000               // exactly 1 kHz
#define DISCOVERY_PERIOD_MS 1000
#define STATUS_PERIOD_MS   1000
#define SAFETY_TEXT "SAFETY: power bank only. Never connect to a laptop or charger while electrodes are on a person."

// ---------------------------------- shared sampler -> loop state ----------------------------------
struct EnvSample {            // one 100 Hz envelope sample, produced by the sampler task
  float env, rms;
  uint32_t tMs;               // millis() when the 10th raw sample of this group was taken
  uint16_t rawMin, rawMax;
  uint8_t satCount;
};
#define ENV_RING 128          // 1.28 s of backlog before new samples are dropped (counted)
#define RAW_RING 512

static EnvSample envRing[ENV_RING];
static volatile uint32_t envHead = 0, envTail = 0;           // head: sampler writes, tail: loop reads
static uint16_t rawRing[RAW_RING];
static volatile uint32_t rawHead = 0, rawTail = 0;
static volatile bool rawMode = false;
static volatile uint32_t isrTicks = 0;                        // 1 kHz ticks seen by the ISR
static volatile uint32_t samplesDone = 0;                     // samples the sampler processed
static volatile uint32_t samplesDropped = 0;                  // missed ticks + env ring overflows
static TaskHandle_t samplerHandle = nullptr;
static hw_timer_t* sampleTimer = nullptr;

// Sampler-task-only state
static BioDsp dsp;

// loop()-only state
static BurstDetector detector;
static SubscriberTable subs;
static ChunkQuality quality;
static WiFiUDP udp;
static float chunkEnv[BIO_CHUNK_N];
static int chunkFill = 0;
static uint32_t chunkTs = 0;
static const char* lastSignal = "ok";
static uint32_t lastDiscoveryMs = 0, lastStatusMs = 0, lastWifiTryMs = 0, lastRateMs = 0, lastRateSamples = 0;
static int adcRateHz = 0;
static uint32_t unknownMsgs = 0, burstsSent = 0, msgCounter = 0;
static bool safetySent = false;
static char serialLine[24];
static int serialLen = 0;

// ---------------------------------- 1 kHz timer ISR + sampler task ----------------------------------
void IRAM_ATTR onSampleTimer() {
  isrTicks++;
  BaseType_t woken = pdFALSE;
  if (samplerHandle) vTaskNotifyGiveFromISR(samplerHandle, &woken);
  if (woken) portYIELD_FROM_ISR(woken);
}

static void samplerTask(void*) {
  uint16_t gMin = 4095, gMax = 0;
  uint8_t sat = 0;
  for (;;) {
    uint32_t pending = ulTaskNotifyTake(pdTRUE, portMAX_DELAY);    // ticks since the last wake-up
    if (pending > 1) samplesDropped += pending - 1;                // we only process one sample per wake-up
    uint16_t raw = (uint16_t)analogRead(ADC_PIN);                  // 12-bit, 0-3.3 V (11 dB attenuation)
    samplesDone++;
    if (rawMode) {
      uint32_t h = rawHead;
      rawRing[h % RAW_RING] = raw;
      rawHead = h + 1;
    }
    if (raw < gMin) gMin = raw;
    if (raw > gMax) gMax = raw;
    if (raw >= BIO_SAT_HI || raw <= BIO_SAT_LO) { if (sat < 255) sat++; }
    float env, rms;
    if (dsp.push((float)raw, env, rms)) {
      uint32_t h = envHead;
      if (h - envTail >= ENV_RING) {                              // loop() fell > 1.28 s behind: drop the NEW sample
        samplesDropped += BIO_DECIM;                              // (never touch envTail here: single-producer ring)
      } else {
        EnvSample& e = envRing[h % ENV_RING];
        e.env = env; e.rms = rms; e.tMs = millis(); e.rawMin = gMin; e.rawMax = gMax; e.satCount = sat;
        envHead = h + 1;
      }
      gMin = 4095; gMax = 0; sat = 0;
    }
  }
}

static void startSampling() {
  analogReadResolution(12);
  analogSetPinAttenuation(ADC_PIN, ADC_11db);                      // full 0-3.3 V range
  xTaskCreatePinnedToCore(samplerTask, "sampler", 4096, nullptr, configMAX_PRIORITIES - 2, &samplerHandle, 1);
  sampleTimer = timerBegin(1000000);                               // 1 MHz tick
  timerAttachInterrupt(sampleTimer, &onSampleTimer);
  timerAlarm(sampleTimer, SAMPLE_PERIOD_US, true, 0);              // auto-reload, exactly 1 kHz
}

// ---------------------------------- UDP out ----------------------------------
static void sendTo(IPAddress ip, uint16_t port, const char* buf, size_t n) {
  if (!n) { Serial.println("[TX] message too large, dropped"); return; }
  udp.beginPacket(ip, port);
  udp.write((const uint8_t*)buf, n);
  udp.endPacket();
}
static void sendSubs(const char* buf, size_t n) {
  uint32_t now = millis();
  subs.prune(now);
  for (auto& e : subs.s) if (e.used) sendTo(IPAddress(e.ip), e.port, buf, n);
}

static void sendDiscovery() {
  char b[300];
  size_t n = fmtDiscovery(b, sizeof(b), DEVICE_ID, FIRMWARE_VERSION, COMMAND_PORT, millis());
  IPAddress sub = WiFi.localIP(); sub[3] = 255;                    // many APs drop 255.255.255.255
  sendTo(IPAddress(255, 255, 255, 255), DISCOVERY_PORT, b, n);
  sendTo(sub, DISCOVERY_PORT, b, n);
}

static void sendStatus() {
  uint32_t now = millis();
  int ns = subs.count(now);
  if (!ns) return;
  char b[480];
  size_t n = fmtStatus(b, sizeof(b), DEVICE_ID, FIRMWARE_VERSION, now, ns, samplesDropped, adcRateHz, lastSignal,
                       unknownMsgs, burstsSent, safetySent ? nullptr : SAFETY_TEXT);
  sendSubs(b, n);
  safetySent = true;                                               // the notice goes out once, with the first status
}

// ---------------------------------- 100 Hz envelope consumer (loop context) ----------------------------------
static void consumeEnvelope() {
  while (envTail != envHead) {
    EnvSample e = envRing[envTail % ENV_RING];
    envTail = envTail + 1;
    if (chunkFill == 0) chunkTs = e.tMs - (BIO_DECIM - 1);         // time of the first raw sample in this chunk
    chunkEnv[chunkFill++] = e.env;
    quality.add(e.rawMin, e.rawMax, e.satCount);
    BurstEvent ev;
    if (detector.push(e.env, e.rms, e.tMs, ev)) {
      burstsSent++;
      char b[200];
      size_t n = fmtBurst(b, sizeof(b), DEVICE_ID, ev.onsetMs, ev.peak, ev.baselineRms);
      sendSubs(b, n);
      Serial.printf("[BURST] t=%lu peak=%.1f baseline_rms=%.2f thr=%.1f\n", (unsigned long)ev.onsetMs, ev.peak,
                    ev.baselineRms, ev.thresholdEnv);
    }
    if (chunkFill == BIO_CHUNK_N) {
      lastSignal = quality.finishChunk();
      char b[420];
      size_t n = fmtChunk(b, sizeof(b), DEVICE_ID, chunkTs, chunkEnv, BIO_CHUNK_N, lastSignal);
      sendSubs(b, n);
      chunkFill = 0;
    }
  }
}

// ---------------------------------- UDP in ----------------------------------
static void handleMessage(const char* msg, IPAddress ip, uint16_t port) {
  uint32_t now = millis();
  uint32_t ip32 = (uint32_t)ip;
  char b[360], cue[48] = "";
  if (!jsonGetString(msg, "cue_id", cue, sizeof(cue))) jsonGetString(msg, "id", cue, sizeof(cue));
  switch (classify(msg)) {
    case MSG_SUBSCRIBE:
      if (!subs.subscribe(ip32, port, now)) Serial.println("[NET] subscriber table full (3 live), ignoring");
      return;
    case MSG_PING: {
      subs.refresh(ip32, port, now);
      size_t n = fmtAck(b, sizeof(b), DEVICE_ID, cue, "accepted", true, nullptr, nullptr, now);
      sendTo(ip, port, b, n);
      return;
    }
    case MSG_MOTOR_CMD: {
      subs.refresh(ip32, port, now);
      size_t n = fmtAck(b, sizeof(b), DEVICE_ID, cue, "rejected", false, "NOT_A_HAPTIC_NODE",
                        "Node B is a bio sensor and has no motors", now);
      sendTo(ip, port, b, n);                                      // ack only to the sender
      return;
    }
    default:
      subs.refresh(ip32, port, now);
      unknownMsgs++;                                               // ignored, never an output
  }
}

static void pollUdp() {
  for (int i = 0; i < 4; i++) {
    int size = udp.parsePacket();
    if (size <= 0) return;
    char buf[400];
    int n = udp.read(buf, sizeof(buf) - 1);
    if (n <= 0) return;
    buf[n] = 0;
    handleMessage(buf, udp.remoteIP(), udp.remotePort());
  }
}

// ---------------------------------- serial commands ----------------------------------
static void printStats() {
  uint32_t now = millis();
  Serial.printf("[STATS] adc_rate=%d Hz (target 1000)  samples_dropped=%lu  isr_ticks=%lu  processed=%lu\n", adcRateHz,
                (unsigned long)samplesDropped, (unsigned long)isrTicks, (unsigned long)samplesDone);
  Serial.printf("[STATS] subscribers=%d  bursts=%lu  unknown_msgs=%lu  signal=%s  wifi=%s  heap=%lu\n", subs.count(now),
                (unsigned long)burstsSent, (unsigned long)unknownMsgs, lastSignal,
                WiFi.status() == WL_CONNECTED ? WiFi.localIP().toString().c_str() : "NO WIFI", (unsigned long)ESP.getFreeHeap());
  if (detector.ready())
    Serial.printf("[STATS] baseline env median=%.1f sd=%.1f threshold=%.1f rms=%.2f\n", detector.med, detector.sd, detector.thr, detector.medRms);
  else
    Serial.printf("[STATS] baseline warming up (%d/%d quiet envelope samples)\n", detector.n, BIO_WARMUP_N);
}

static void pollSerial() {
  while (Serial.available()) {
    char c = (char)Serial.read();
    if (c == '\n' || c == '\r') {
      serialLine[serialLen] = 0; serialLen = 0;
      if (!strcmp(serialLine, "raw")) { rawMode = !rawMode; rawTail = rawHead; Serial.printf("[RAW] %s (bench only; Serial Plotter)\n", rawMode ? "ON" : "OFF"); }
      else if (!strcmp(serialLine, "stats")) printStats();
      else if (!strcmp(serialLine, "help")) Serial.println("commands: raw | stats | help");
      else if (serialLine[0]) Serial.println("unknown command (raw | stats | help)");
    } else if (serialLen < (int)sizeof(serialLine) - 1) {
      serialLine[serialLen++] = c;
    }
  }
}

static void printRaw() {
  int budget = 64;
  while (rawTail != rawHead && budget-- > 0) {
    if (Serial.availableForWrite() < 8) return;                    // never block loop() on a slow serial link
    if (rawHead - rawTail > RAW_RING) rawTail = rawHead - RAW_RING;
    Serial.println(rawRing[rawTail % RAW_RING]);
    rawTail = rawTail + 1;
  }
}

// ---------------------------------- Wi-Fi ----------------------------------
static void connectWifiBlocking() {
  WiFi.mode(WIFI_STA);
  WiFi.setSleep(false);                                            // modem sleep adds 100+ ms to UDP
  WiFi.begin(WIFI_SSID, WIFI_PASS);
  Serial.printf("[NET] connecting to '%s'", WIFI_SSID);
  uint32_t t0 = millis();
  while (WiFi.status() != WL_CONNECTED) {
    delay(300); Serial.print(".");
    if (millis() - t0 > 20000) {
      Serial.println("\n[NET] not connected - 2.4 GHz hotspot? password right? retrying");
      WiFi.disconnect(); WiFi.begin(WIFI_SSID, WIFI_PASS); t0 = millis();
    }
  }
  Serial.printf("\n[NET] connected. IP %s  MAC %s\n", WiFi.localIP().toString().c_str(), WiFi.macAddress().c_str());
}

// ---------------------------------- setup / loop ----------------------------------
void setup() {
  Serial.begin(115200);
  delay(300);
  Serial.println();
  Serial.println("=====================================================================");
  Serial.println(SAFETY_TEXT);
  Serial.println("=====================================================================");
  Serial.printf("Phantom Hand bio_node fw %s (%s), ADC GPIO%d, 1 kHz -> 100 Hz envelope\n", FIRMWARE_VERSION, DEVICE_ID, ADC_PIN);
  startSampling();                                                 // sampling runs from here on, Wi-Fi or not
  connectWifiBlocking();
  udp.begin(COMMAND_PORT);
  Serial.printf("[NET] listening UDP %d (subscribe), discovery -> %d every %d ms. Serial: raw | stats | help\n",
                COMMAND_PORT, DISCOVERY_PORT, DISCOVERY_PERIOD_MS);
  lastRateMs = millis();
}

void loop() {
  uint32_t now = millis();
  if (WiFi.status() != WL_CONNECTED) {
    if (now - lastWifiTryMs > 5000) { lastWifiTryMs = now; WiFi.disconnect(); WiFi.begin(WIFI_SSID, WIFI_PASS); }
  } else {
    pollUdp();
    if (now - lastDiscoveryMs >= DISCOVERY_PERIOD_MS) { lastDiscoveryMs = now; sendDiscovery(); }
  }
  consumeEnvelope();                                               // keeps the burst detector fed even with no subscriber
  if (now - lastRateMs >= 1000) {
    uint32_t done = samplesDone;
    adcRateHz = (int)((done - lastRateSamples) * 1000UL / (now - lastRateMs));
    lastRateSamples = done; lastRateMs = now;
  }
  if (now - lastStatusMs >= STATUS_PERIOD_MS) { lastStatusMs = now; if (WiFi.status() == WL_CONNECTED) sendStatus(); }
  pollSerial();
  if (rawMode) printRaw();
  delay(1);                                                        // yield; sampling is on its own task
}
